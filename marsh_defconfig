## marsh_defconfig
```kconfig
# Архитектура x86_64, загрузка BIOS/ISO
BR2_x86_64=y
BR2_PACKAGE_HOST_LINUX_HEADERS_CUSTOM_6_6=y

# Системные настройки
BR2_TARGET_GENERIC_HOSTNAME="marsh"
BR2_TARGET_GENERIC_ISSUE="Marsh OS \\r \\l"
BR2_INIT_RUNIT=y
BR2_ROOTFS_DEVICE_CREATION_DYNAMIC_EUDEV=y
BR2_TARGET_GENERIC_ROOT_PASSWD="marsh"        # пароль root (можно оставить пустым)

# Ядро
BR2_LINUX_KERNEL=y
BR2_LINUX_KERNEL_CUSTOM_VERSION=y
BR2_LINUX_KERNEL_CUSTOM_VERSION_VALUE="6.6.32"
BR2_LINUX_KERNEL_USE_DEFCONFIG=y
BR2_LINUX_KERNEL_DEFCONFIG="x86_64"

# Инструменты для live-образа
BR2_PACKAGE_BUSYBOX=y
BR2_PACKAGE_EUDEV=y
BR2_PACKAGE_UTIL_LINUX=y
BR2_PACKAGE_UTIL_LINUX_MOUNT=y
BR2_PACKAGE_UTIL_LINUX_AGETTY=y

# Образ ISO
BR2_TARGET_ROOTFS_ISO9660=y
BR2_TARGET_ROOTFS_ISO9660_LABEL="MARSH_OS"
BR2_TARGET_ROOTFS_ISO9660_BOOT_MENU="board/marsh/isolinux.cfg"
```
